#include <behaviors.dtsi>
#include <dt-bindings/zmk/keys.h>
#include <dt-bindings/zmk/rgb.h>
#include <dt-bindings/zmk/bt.h>

/ {
    behaviors {
        inc_dec_kp_2: behavior_sensor_rotate_key_press_2 {
            compatible = "zmk,behavior-sensor-rotate-key-press";
            label = "ENC_KEY_PRESS_2";
            triggers-per-rotation = <60>;
            #sensor-binding-cells = <2>;
            
 / {
	macros {
		capture_prev_30s: capture_prev_30s {
		label = "Game_bar_capture_prev_30s";
		compatible = "zmk,behavior-macro";
		#binding-cells = <0>;
		bindings
			= <&macro_tap_time 500>
			  ,<&kp LEFT_WIN &kp LEFT_ALT &kp G>
        };
    };
};

&inc_dec_kp {
	triggers-per-rotation = <10>;
};
&def_lshft {
	triggers-per-rotation = <10>;
};

/ {
	keymap {
		compatible = "zmk,keymap";

		default_layer {
			//PREV | PLAY/PAUSE | NEXT
			bindings = <&kp C_PREV &lt 4 &capture_prev_30s &kp C_NEXT>;
			sensor-bindings = <&inc_dec_kp C_VOL_UP C_VOL_DN>;
			ledoverride;
			r = <150>;
			g = <150>;
			b = <150>;
		};
		one {
			//PREV | PLAY/PAUSE | NEXT
			bindings = <&kp C_PREV &lt 4 C_PP &kp C_NEXT>;
			sensor-bindings = <&inc_dec_kp C_VOL_UP C_VOL_DN>;
			ledoverride;
			r = <0>;
			g = <0>;
			b = <0>;
		};
		two {
			//PREV | PLAY/PAUSE | NEXT
			bindings = <&kp C_PREV &lt 4 C_PP &kp C_NEXT>;
			sensor-bindings = <&inc_dec_kp_2 DOWN UP>;
			ledoverride;
			r = <255>;
			g = <10>;
			b = <0>;
		};
		three {
			//PREV | PLAY/PAUSE | NEXT
			bindings = <&kp DOWN &lt 4 SPACE &kp UP>;
			sensor-bindings = <&inc_dec_kp_2 RIGHT LEFT>;
			ledoverride;
			r = <0>;
			g = <15>;
			b = <200>;
		};
		shift {
			//PREV | PLAY/PAUSE | NEXT
			bindings = <&bt BT_CLR &trans &rgb_ug RGB_TOG>;
			sensor-bindings = <&def_lshft>;
		};
	};
};
